## meta-bsp/conf/machine/imx8dxlevk.conf
```bitbake
require conf/machine/imx8dxla1-lpddr4-evk.conf

KERNEL_DEVICETREE += "freescale/imx8dxl-ddr3l-evk-rpmsg.dtb \
                      freescale/imx8dxl-ddr3l-evk.dtb \
"
```
